## arch/arm/soc/unisoc_uwp/Kconfig
```kconfig
# Kconfig - UNISOC UWP SOC
#

config SOC_FAMILY_UWP
	bool
	# omit prompt to signify a "hidden" option
	default n

if SOC_FAMILY_UWP
config SOC_FAMILY
	string
	default "unisoc_uwp"
endif

source "arch/arm/soc/unisoc_uwp/uwp5/Kconfig.soc"
```

## arch/arm/soc/unisoc_uwp/Kconfig.soc
```kconfig
# Kconfig - UNISOC UWP SOC
#

source "arch/arm/soc/unisoc_uwp/uwp5/Kconfig.series"
```

## arch/arm/soc/unisoc_uwp/uwp5/Kconfig.defconfig.series
```kconfig
# Kconfig.defconfig.series - UNISOC UWP Family
#

if SOC_SERIES_UWP5

source "arch/arm/soc/unisoc_uwp/uwp5/Kconfig.defconfig.uwp566x"

config SOC_SERIES
	string
	default "uwp5"

endif # SOC_SERIES_UWP5
```

## arch/arm/soc/unisoc_uwp/uwp5/Kconfig.defconfig.uwp566x
```kconfig
# Kconfig.defconfig.uwp566x
#

if SOC_UWP566x

config SOC
	string
	default "uwp566x"

config NUM_IRQS
	int
	# must be >= the highest interrupt number used
	default 179

config SYS_CLOCK_HW_CYCLES_PER_SEC
	int
	default 416000000

endif # SOC_UWP566x
```

## arch/arm/soc/unisoc_uwp/uwp5/Kconfig.series
```kconfig
# Kconfig.series - UNISOC UWP5
#

config  SOC_SERIES_UWP5
	bool "Unisoc UWP5"
	select CPU_CORTEX_M4
	select SOC_FAMILY_UWP
	select CPU_HAS_SYSTICK
	help
	  Enable support for Unisoc UWP5
```

## arch/arm/soc/unisoc_uwp/uwp5/Kconfig.soc
```kconfig
# Kconfig.soc - UNISOC UWP566x
#

choice
prompt "Unisoc UWP566x MCU Selection"
depends on SOC_SERIES_UWP5

config SOC_UWP566x
	bool "uwp566x"
endchoice

if SOC_UWP566x

config UWP566x_DEBUG
	bool "Prepend debug header, disabling flash verification"
	depends on XIP
	default y if XIP
	default n if !XIP

endif # SOC_UWP566x
```

## boards/arm/96b_ivy5661/96b_ivy5661_defconfig
```kconfig
CONFIG_ARM=y
CONFIG_SOC_FAMILY_UWP=y
CONFIG_SOC_SERIES_UWP566X=y
CONFIG_SOC_UWP5661=y
CONFIG_BOARD_96B_IVY5661=y
CONFIG_CORTEX_M_SYSTICK=y
CONFIG_HAS_UWP=y

# pinmux
CONFIG_PINMUX=y
CONFIG_PINMUX_UWP=y

# gpio
CONFIG_GPIO=y
CONFIG_GPIO_UWP=y
CONFIG_GPIO_UWP_P0=y
CONFIG_GPIO_UWP_P1=y
CONFIG_GPIO_UWP_P2=y

# watchdog
CONFIG_WATCHDOG=y
CONFIG_WDT_UWP=y

# enable uart driver
CONFIG_SERIAL=y
CONFIG_UART_UWP=y
CONFIG_SERIAL_HAS_DRIVER=y
CONFIG_UART_INTERRUPT_DRIVEN=y

# enable console
CONFIG_CONSOLE=y
CONFIG_UART_CONSOLE=y

CONFIG_MULTI_LEVEL_INTERRUPTS=y
CONFIG_2ND_LEVEL_INTERRUPTS=y
CONFIG_UWP_ICTL=y
CONFIG_UWP_ICTL_0=y
CONFIG_UWP_ICTL_1=y
CONFIG_UWP_ICTL_2=y

CONFIG_FLASH=y
CONFIG_FLASH_MAP=y
CONFIG_ARM_MPU=n
CONFIG_FCB=y

CONFIG_FLASH_PAGE_LAYOUT=y

CONFIG_SOC_FLASH_UWP=y
CONFIG_USE_UWP_HAL_SFC=y

CONFIG_SIPC=y

#CONFIG_AON_UART_UWP=y

CONFIG_LED=y
CONFIG_LED_UWP=y


CONFIG_TEXT_SECTION_OFFSET=0
```

## boards/arm/ivy5662/Kconfig.board
```kconfig
# Kconfig - board IVY5662 board configuration
#

config BOARD_IVY5662
	bool "IVY5662"
	depends on SOC_UWP5662
```

## boards/arm/ivy5662/Kconfig.defconfig
```kconfig
# Kconfig -  IVY5662 board configuration
#

if BOARD_IVY5662

config BOARD
	string
	default "ivy5662"

config 2ND_LVL_INTR_00_OFFSET
	default 0x1
config 2ND_LVL_INTR_01_OFFSET
	default 0x0
config 2ND_LVL_INTR_02_OFFSET
	default 0x14

config MAX_IRQ_PER_AGGREGATOR
	default 32
config NUM_2ND_LEVEL_AGGREGATORS
	default 3
config 2ND_LVL_ISR_TBL_OFFSET
	default 64
endif # BOARD_IVY5662
```

## boards/arm/ivy5662/ivy5662_defconfig
```kconfig
CONFIG_ARM=y
CONFIG_SOC_FAMILY_UWP=y
CONFIG_SOC_SERIES_UWP566X=y
CONFIG_SOC_UWP5662=y
CONFIG_BOARD_IVY5662=y
CONFIG_CORTEX_M_SYSTICK=y
CONFIG_HAS_UWP=y

CONFIG_PRINTK=y

#enable GPIO driver
CONFIG_GPIO=y
CONFIG_GPIO_UWP=y
CONFIG_GPIO_UWP_P0=y

# enable uart driver
CONFIG_SERIAL=y
CONFIG_UART_UWP=y
CONFIG_SERIAL_HAS_DRIVER=y
CONFIG_UART_INTERRUPT_DRIVEN=y

# enable console
CONFIG_CONSOLE=y
CONFIG_UART_CONSOLE=y

CONFIG_WATCHDOG=y
CONFIG_WDT_UWP=y

CONFIG_MULTI_LEVEL_INTERRUPTS=y
CONFIG_2ND_LEVEL_INTERRUPTS=y
CONFIG_UWP_ICTL=y
CONFIG_UWP_ICTL_0=y
CONFIG_UWP_ICTL_1=y
CONFIG_UWP_ICTL_2=y

CONFIG_FLASH=y
CONFIG_FLASH_MAP=y
CONFIG_ARM_MPU=n
CONFIG_FCB=y

CONFIG_SETTINGS=y
CONFIG_SETTINGS_FCB=y

CONFIG_SOC_FLASH_UWP=y
CONFIG_USE_UWP_HAL_SFC=y

CONFIG_TEXT_SECTION_OFFSET=0
```

## boards/arm/uwp566x_evb/Kconfig.board
```kconfig
# Kconfig - UNISOC UWP566x EVB Board
#

config  BOARD_UWP566x_EVB
	bool "UNISOC uwp566x evb"
	depends on SOC_UWP566x
```

## boards/arm/uwp566x_evb/Kconfig.defconfig
```kconfig
# Kconfig - UNISOC UWP566x EVB board configuration
#

if BOARD_UWP566x_EVB

config BOARD
	string
	default "uwp566x_evb"

endif # BOARD_UWP566x_EVB
```

## boards/arm/uwp566x_evb/uwp566x_evb_defconfig
```kconfig
CONFIG_ARM=y
CONFIG_SOC_FAMILY_UWP=y
CONFIG_SOC_SERIES_UWP5=y
CONFIG_SOC_UWP566x=y
CONFIG_BOARD_UWP566x_EVB=y
CONFIG_CORTEX_M_SYSTICK=y
CONFIG_FLASH=n
CONFIG_XIP=n
CONFIG_HAS_UWP=y
CONFIG_USE_UWP_HAL_UART=y

CONFIG_PRINTK=y

#enable GPIO driver
CONFIG_GPIO=y
CONFIG_GPIO_UWP=y
CONFIG_GPIO_UWP_P0=y

# enable uart driver
CONFIG_SERIAL=y
CONFIG_SERIAL_HAS_DRIVER=y
CONFIG_UART_UWP=y
CONFIG_UART_INTERRUPT_DRIVEN=y

# enable console
CONFIG_CONSOLE=y
CONFIG_UART_CONSOLE=y

CONFIG_WATCHDOG=y
CONFIG_WDT_UWP=y
CONFIG_FLASH=y
CONFIG_SOC_FLASH_UWP=y
CONFIG_USE_UWP_HAL_SFC=y

CONFIG_INTC_UWP=y
CONFIG_AON_INTC_UWP=y
CONFIG_IPI_UWP=y
#CONFIG_EIC_UWP=y
#CONFIG_AON_EIC_UWP=y

CONFIG_TEXT_SECTION_OFFSET=0
```

## drivers/bluetooth/unisoc/Kconfig
```kconfig
# Kconfig - Bluetooth drivers configuration options

#
# Copyright (c) 2018
#
# SPDX-License-Identifier: Apache-2.0
#

comment "Unisoc Bluetooth HCI Driver Options"

config BT_UNISOC_UWP56XX
	bool "UWP56XX"
```

## drivers/dma/Kconfig.uwp
```kconfig
# Kconfig.cavs - CAVS DMA configuration options
#
#
# Copyright (c) 2018 Intel Corporation
#
# SPDX-License-Identifier: Apache-2.0
#

menuconfig DMA_UWP
	bool "Enable UWP DMA driver"
	help
	  UWP DMA driver.
```

## drivers/flash/Kconfig.uwp
```kconfig
# SPDX-License-Identifier: Apache-2.0

config SOC_FLASH_UWP
	bool "Unisoc UWP flash driver"
	depends on FLASH && USE_UWP_HAL_SFC
	select FLASH_HAS_DRIVER_ENABLED
	select FLASH_HAS_PAGE_LAYOUT
	select FLASH_PAGE_LAYOUT
	help
	  Enables the Unisoc UWP flash driver.
```

## drivers/gpio/Kconfig.uwp
```kconfig
# Kconfig.cc32xx- CC32XX GPIO configuration options
#

menuconfig GPIO_UWP
	bool "Unisoc UWP GPIO driver"
	depends on GPIO && SOC_FAMILY_UWP
	default n
	help
	  Enable the GPIO driver on TI SimpleLink CC32xx boards

if GPIO_UWP

config GPIO_UWP_P0
	bool "GPIO block A0"
	depends on GPIO_UWP
	default n
	help
	  Include support for the GPIO port A0.


config GPIO_UWP_P1
	bool "GPIO block A1"
	depends on GPIO_UWP
	default n
	help
	  Include support for the GPIO port A1.

config GPIO_UWP_P1_NAME
	string "Driver name"
	depends on GPIO_UWP_P1
	default "UWP_GPIO_P1"

config GPIO_UWP_P2
	bool "GPIO block A2"
	depends on GPIO_UWP
	default n
	help
	  Include support for the GPIO port A2.

config GPIO_UWP_P2_NAME
	string "Driver name"
	depends on GPIO_UWP_P2
	default "UWP_GPIO_P2"

endif # GPIO_UWP
```

## drivers/i2c/Kconfig.unisoc
```kconfig
config I2C_UWP56XX
	bool "UNISOC I2C driver"
	default n
	help
	  This option enables the I2C driver for Unisoc
```

## drivers/led/Kconfig
```kconfig
#
# Copyright (c) 2018 Linaro Limited
#
# SPDX-License-Identifier: Apache-2.0
#

# Top-level configuration file for LED drivers.

menuconfig LED
	bool "LED drivers"
	help
	  Include LED drivers in the system configuration.

if LED

module = LED
module-str = led
source "subsys/logging/Kconfig.template.log_config"

config LED_INIT_PRIORITY
	int "LED initialization priority"
	default 90
	help
	  System initialization priority for LED drivers.

config LED_DRV_NAME
	string "Driver name"
	default "led"

config LED_PIN1
	int "GPIO pin that the LED is connected to"
	default 1

config LED_PIN3
	int "GPIO pin that the LED is connected to"
	default 3

source "drivers/led/Kconfig.lp3943"
source "drivers/led/Kconfig.lp5562"
source "drivers/led/Kconfig.pca9633"
source "drivers/led/Kconfig.uwp"

endif # LED
```

## drivers/led/Kconfig.uwp
```kconfig
#
# Copyright (c) 2018, UNISOC Incorporated
#
# SPDX-License-Identifier: Apache-2.0
#


menuconfig LED_UWP
	bool "Unisoc uwp led driver support"
	default n
	depends on LED
	depends on GPIO_UWP

if LED_UWP

config LED_DRV_NAME
	string "Driver name"
	default "led"

config LED_PIN1
	int "GPIO pin that the LED is connected to"
	default 1

config LED_PIN2
	int "GPIO pin that the LED is connected to"
	default 3

config LED_PIN3
	int "GPIO pin that the LED is connected to"
	default 2

endif
```

## drivers/pinmux/Kconfig.uwp
```kconfig
# Kconfig - DRIVER PINMUX
#
# SPDX-License-Identifier: Apache-2.0
#

menuconfig PINMUX_UWP
	bool "UWP pinmux driver"
	depends on PINMUX
	help
	  Enable the pinmux driver.

if PINMUX_UWP

config PINMUX_UWP_DEV_NAME
	string "Pinmux driver name"
	depends on PINMUX_UWP
	default "pinmux_drv"

endif # PINMUX_UWP
```

## drivers/serial/Kconfig.uwp
```kconfig
menuconfig UART_UWP
	depends on SOC_SERIES_UWP566X
	bool "UWP UART driver"
	default n
	select SERIAL_HAS_DRIVER
	select SERIAL_SUPPORT_INTERRUPT
	depends on SOC_FAMILY_UWP
	help
	  This option enables the UWP UART driver, for UART_0.

menuconfig UART1_UWP
	depends on SOC_SERIES_UWP566X
	bool "UWP UART1 driver"
	default n
	select SERIAL_HAS_DRIVER
	select SERIAL_SUPPORT_INTERRUPT
	depends on SOC_FAMILY_UWP
	help
	  This option enables the UWP UART driver, for UART_1.

menuconfig AON_UART_UWP
	depends on SOC_SERIES_UWP566X
	bool "UWP AON UART driver"
	default n
	select SERIAL_HAS_DRIVER
	select SERIAL_SUPPORT_INTERRUPT
	depends on SOC_FAMILY_UWP
	help
	  This option enables the UWP AON UART driver.

menuconfig WCI2_UWP
	depends on SOC_SERIES_UWP566X
	bool "UWP WCI2 UART driver"
	default n
	select SERIAL_HAS_DRIVER
	select SERIAL_SUPPORT_INTERRUPT
	depends on SOC_FAMILY_UWP
	help
	  This option enables the UWP WCI2 UART driver, for WCI2.
```

## drivers/watchdog/Kconfig.uwp
```kconfig
#
# Copyright (c) 2018, UNISOC Incorporated
#
# SPDX-License-Identifier: Apache-2.0
#

menuconfig WDT_UWP
	bool "UNISOC UWP Watchdog Driver"
	depends on SOC_FAMILY_UWP
	default y
	help
	  Enable WDT driver for UNISOC UWP MCU.
```

## drivers/wifi/uwp/Kconfig
```kconfig
menuconfig WIFI_UWP
	bool "Unisoc uwp wifi driver support"
	default y
	select WIFI_OFFLOAD
	select NET_L2_WIFI_MGMT

if WIFI_UWP
config WIFI_UWP_STA_NAME
	string "STA device name"
	default "UWP_STA"
config WIFI_UWP_AP_NAME
	string "SoftAP device name"
	default "UWP_AP"
config WIFI_UWP_USE_SRAM
	bool "Wifi use sram"
	default n
endif
```
