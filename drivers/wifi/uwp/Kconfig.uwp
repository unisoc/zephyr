## drivers/wifi/uwp/Kconfig.uwp
```kconfig
#
# Copyright (c) 2018, UNISOC Incorporated
#
# SPDX-License-Identifier: Apache-2.0
#


menuconfig WIFI_UWP
	bool "Unisoc uwp wifi driver support"
	default n
	depends on WIFI
	select NETWORKING
	select NET_BUF
	select NET_L2_ETHERNET
	select NET_IPV4

if WIFI_UWP

config WIFI_STA_DRV_NAME
	string "STA driver name"
	default "WIFI_STA"

config WIFI_AP_DRV_NAME
	string "SoftAP driver name"
	default "WIFI_AP"

config WIFI_UWP_MAX_RX_ADDR_COUNT
	int "Max rx addr count each time"
	default 32
	help
	  Max count CP can receive each time.

config WIFI_UWP_NET_BUF_START_ADDR
	int "Net buffer start address(decimal number)"
	default 1702911

config WIFI_UWP_TX_BUF_COUNT
	int "TX buffer count"
	default 32

config WIFI_UWP_RX_BUF_COUNT
	int "RX buffer count"
	default 96

config WIFI_UWP_NET_BUF_SIZE
	int "Net buffer size"
	default 1800

endif
```

## dts/bindings/gpio/unisoc,uwp-gpio.yaml
```yaml
---
title: UNISOC UWP GPIO PORT driver
version: 0.1

description: >
    This is a representation of the UWP GPIO PORT nodes

properties:
    compatible:
      type: string
      category: required
      description: compatible strings
      constraint: "unisoc,uwp-gpio"
      generation: define

    reg:
      type: int
      description: mmio register space
      generation: define
      category: required

    interrupts:
      type: compound
      category: required
      description: required interrupts
      generation: define

    label:
      type: string
      category: required
      description: Human readable string describing the device (used by Zephyr for API name)
      generation: define


"#cells":
  - pin
  - flags
...
```

## dts/bindings/serial/unisoc,uwp-wci2.yaml
```yaml
---
title: UNISOC UWP WCI2
version: 0.1

description: >
    This binding gives a base representation of the UNISOC UWP WCI2

inherits:
    !include uart.yaml

properties:
    compatible:
      type: string
      category: required
      description: compatible strings
      constraint: "unisoc,uwp-wci2"

    reg:
      type: array
      description: mmio register space
      generation: define
      category: required

    interrupts:
      type: array
      category: required
      description: required interrupts
      generation: define
...
```

## ext/lib/engpc/Kconfig
```kconfig
#
# For a description of the syntax of this configuration file,
# see the file kconfig-language.txt in the NuttX tools repository.
#

config ENGPC
	bool "ENGPC test tool"
	default n
	help
		Enable ENGPC test tool for bt/wifi npi test
```

## ext/lib/ipc/sipc/Kconfig
```kconfig
config SIPC 
        bool "UNISOC sipc lib"
        default n
        help
		  enbale sipc feature
```

## ext/lib/iwnpi/Kconfig
```kconfig
config IWNPI
        bool "iwnpi tool for wifi npi test"
        default n
        help
          Enable the iwnpi tool for wifi npi test
```

## soc/arm/unisoc_uwp/uwp566x/Kconfig.defconfig.uwp5662
```kconfig
# Kconfig.defconfig.uwp5662
#

if SOC_UWP5662

config SOC
	string
	default "uwp5662"

config NUM_IRQS
	int
	# must be >= the highest interrupt number used
	default 179

config SYS_CLOCK_HW_CYCLES_PER_SEC
	int
	default 416000000

endif # SOC_UWP5662
```

## soc/arm/unisoc_uwp/uwp566x/Kconfig.soc
```kconfig
# Kconfig.soc - UNISOC UWP5661
#

choice
prompt "Unisoc UWP5661 MCU Selection"
depends on SOC_SERIES_UWP566X

config SOC_UWP5661
	bool "uwp5661"

config SOC_UWP5662
	bool "uwp5662"

endchoice

if SOC_UWP5661

config UWP5661_DEBUG
	bool "Prepend debug header, disabling flash verification"
	depends on XIP
	default y if XIP
	default n if !XIP

endif # SOC_UWP5661

if SOC_UWP5662

config UWP5662_DEBUG
	bool "Prepend debug header, disabling flash verification"
	depends on XIP
	default y if XIP
	default n if !XIP

endif # SOC_UWP5662
```

## subsys/wifi/Kconfig
```kconfig
# Kconfig - WiFi configuration options
#
# Copyright (c) 2016 UNISOC Corporation
#
# SPDX-License-Identifier: Apache-2.0
#

menu "WiFi"

config WIFIMGR
        bool "WiFi Manager"
	depends on CONFIG_WIFI
	select CONFIG_POSIX_API
	select CONFIG_PTHREAD_IPC
	select CONFIG_POSIX_MQUEUE
        help
		Enable the WiFi Manager.
		By default, WiFi manger is build as only a library.

if WIFIMGR

config WIFIMGR_CLI
	bool "WiFi Manager Client"
	default y
	help
		A client that can interact with WiFi manger,
		which can be ran from shell.

config WIFIMGR_DHCPC
	bool "Enable DHCP client"
	select CONFIG_NET_IPV4
	select CONFIG_NET_DHCPV4
	default y
	help
		Start DHCP client by WiFi manger.

endif # WiFi

endmenu
```
