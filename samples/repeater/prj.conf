## CMakeLists.txt
```
include($ENV{ZEPHYR_BASE}/cmake/app/boilerplate.cmake NO_POLICY_SCOPE)
project(NONE)

target_sources(app PRIVATE src/main.c)

target_sources_ifdef(
  CONFIG_BT
  app PRIVATE
  src/bluetooth/blues.c
  src/bluetooth/light.c
  src/bluetooth/health.c
  src/bluetooth/throughput.c
  src/bluetooth/mesh.c
  src/bluetooth/bt_npi.c
  src/bluetooth/bt_eng.c
  )

target_sources_ifdef(
  CONFIG_BT_WIFIMGR_SERVICE
  app PRIVATE
  src/bluetooth/wifi_manager_service.c
  )
```

## sample.yaml
```
sample:
  description: Wi-Fi Repeater, based on UWP566X
    application
  name: repeater
  platforms: all
common:
    tags: samples
    harness: console
    harness_config:
      type: one_line
      regex:
        - "Wi-Fi Repeater! (.*)"
tests:
  sample.helloworld.multithread:
    tags: samples
```

## prj.conf
```kconfig
# nothing here

CONFIG_BOOT_BANNER=n
CONFIG_BUILD_TIMESTAMP=y
CONFIG_STDOUT_CONSOLE=y
#CONFIG_BOOTLOADER_MCUBOOT=y
#CONFIG_FLASH_BASE_ADDRESS=0x180000
#CONFIG_TEXT_SECTION_OFFSET=0x200

CONFIG_CONSOLE_PULL=y
CONFIG_CONSOLE_SHELL=y
CONFIG_WATCHDOG=y

CONFIG_SYS_LOG=y
CONFIG_SYS_LOG_SHOW_COLOR=y
CONFIG_SYS_LOG_SHOW_TAGS=y
CONFIG_SYS_LOG_DEFAULT_LEVEL=3
CONFIG_SYS_LOG_OVERRIDE_LEVEL=3

CONFIG_FILE_SYSTEM=y
CONFIG_FAT_FILESYSTEM_ELM=y
CONFIG_FILE_SYSTEM_SHELL=y

CONFIG_DISK_ACCESS=y
CONFIG_DISK_ACCESS_FLASH=y
CONFIG_DISK_FLASH_DEV_NAME="UWP_FLASH"
CONFIG_DISK_FLASH_START=0x22C0000
CONFIG_DISK_FLASH_MAX_RW_SIZE=4096
CONFIG_DISK_FLASH_ERASE_ALIGNMENT=0x1000
CONFIG_DISK_ERASE_BLOCK_SIZE=4096
CONFIG_DISK_VOLUME_SIZE=0x80000

CONFIG_AON_UART_UWP=y

CONFIG_NETWORKING=y
CONFIG_NET_BUF=y
CONFIG_NET_BUF_USER_DATA_SIZE=8
CONFIG_NET_IPV4=y
CONFIG_NET_BUF_DATA_SIZE=1800
CONFIG_NET_DHCPV4=y
CONFIG_NET_IPV6=n
CONFIG_NET_BUF_RX_COUNT=128
CONFIG_NET_PKT_RX_COUNT=64
CONFIG_NET_BUF_TX_COUNT=32
CONFIG_NET_PKT_TX_COUNT=16
CONFIG_WIFI=y
CONFIG_WIFI_UWP=y
CONFIG_WIFI_UWP_USE_SRAM=y
CONFIG_WIFI_UWP_TOTAL_RX_ADDR_NUM=120

CONFIG_PTHREAD_IPC=y
CONFIG_POSIX_MQUEUE=y
CONFIG_WIFIMGR=y
CONFIG_WIFIMGR_CLI=y
CONFIG_WIFIMGR_DHCPC=y

#TEST_RANDOM_GENERATOR=y
#TIMER_RANDOM_GENERATOR=y

CONFIG_NET_L2_ETHERNET=y
#CONFIG_NET_L2_WIFI_MGMT=y
#CONFIG_NET_L2_WIFI_SHELL=y

CONFIG_TEST=y

#CONFIG_FLASH=y
#CONFIG_SOC_FLASH_UWP360=y
#CONFIG_USE_UWP360_HAL_SFC=y

CONFIG_SIPC=y
CONFIG_IWNPI=n
CONFIG_ENGPC=n

CONFIG_NET_SHELL=y

CONFIG_XIP=y
CONFIG_BOOTLOADER_MCUBOOT=y
CONFIG_TEXT_SECTION_OFFSET=0x1000

CONFIG_BT_WIFIMGR_SERVICE=y
CONFIG_BT_UNISOC=y
CONFIG_BT_UNISOC_UWP56XX=y
CONFIG_BT=y
CONFIG_BT_SIPC=y
CONFIG_BT_SHELL=y
CONFIG_HEAP_MEM_POOL_SIZE=16384
CONFIG_MAIN_STACK_SIZE=4096
CONFIG_BT_HCI_TX_STACK_SIZE=4096
CONFIG_BT_RX_STACK_SIZE=4096
CONFIG_BT_RX_BUF_LEN=1024
CONFIG_BT_L2CAP_TX_MTU=255
CONFIG_BT_HCI_RESERVE=1
CONFIG_BT_PERIPHERAL=y
CONFIG_BT_CENTRAL=y
CONFIG_BT_DEVICE_NAME="BLUES"
CONFIG_BT_CONN=y
CONFIG_BT_HCI_ACL_FLOW_CONTROL=n
CONFIG_BT_ATT_PREPARE_COUNT=5

CONFIG_BT_MESH=y
CONFIG_BT_MESH_PROV=y
CONFIG_BT_MESH_HEALTH_CLI=y
CONFIG_BT_MESH_CFG_CLI=y
CONFIG_BT_MESH_SELF_TEST=y
CONFIG_BT_MESH_SHELL=y
CONFIG_BT_MESH_IV_UPDATE_TEST=y
CONFIG_BT_MESH_PB_GATT=y
#CONFIG_BT_MESH_LOW_POWER=y
#CONFIG_BT_MESH_FRIEND=y
CONFIG_BT_MESH_PROXY=y
CONFIG_BT_HCI_VS_EXT=n
#CONFIG_BT_SETTINGS=y
#CONFIG_BT_DEBUG_MONITOR=y
CONFIG_BT_DEBUG_LOG=y
#CONFIG_THREAD_MONITOR=y
CONFIG_SYSTEM_WORKQUEUE_STACK_SIZE=4096
CONFIG_BT_MESH_ADV_BUF_COUNT=80

#CONFIG_BT_SMP=y
CONFIG_BT_TINYCRYPT_ECC=y

CONFIG_TEST_RANDOM_GENERATOR=y
CONFIG_TIMER_RANDOM_GENERATOR=y

CONFIG_I2C=y
CONFIG_I2C_UWP56XX=y
CONFIG_NET_BUF_POOL_USAGE=y
```

## prj_debug.conf
```kconfig
# nothing here

CONFIG_BOOT_BANNER=n
CONFIG_BUILD_TIMESTAMP=y
CONFIG_STDOUT_CONSOLE=y
#CONFIG_BOOTLOADER_MCUBOOT=y
#CONFIG_FLASH_BASE_ADDRESS=0x180000
#CONFIG_TEXT_SECTION_OFFSET=0x200

CONFIG_CONSOLE_PULL=y
CONFIG_CONSOLE_SHELL=y
CONFIG_WATCHDOG=y

CONFIG_SYS_LOG=y
CONFIG_SYS_LOG_SHOW_COLOR=y
CONFIG_SYS_LOG_SHOW_TAGS=y
CONFIG_SYS_LOG_DEFAULT_LEVEL=3
CONFIG_SYS_LOG_OVERRIDE_LEVEL=3

CONFIG_FILE_SYSTEM=y
CONFIG_FAT_FILESYSTEM_ELM=y
CONFIG_FILE_SYSTEM_SHELL=y

CONFIG_DISK_ACCESS=y
CONFIG_DISK_ACCESS_FLASH=y
CONFIG_DISK_FLASH_DEV_NAME="UWP_FLASH"
CONFIG_DISK_FLASH_START=0x22C0000
CONFIG_DISK_FLASH_MAX_RW_SIZE=4096
CONFIG_DISK_FLASH_ERASE_ALIGNMENT=0x1000
CONFIG_DISK_ERASE_BLOCK_SIZE=4096
CONFIG_DISK_VOLUME_SIZE=0x80000

CONFIG_AON_UART_UWP=y

CONFIG_NETWORKING=y
CONFIG_NET_BUF=y
CONFIG_NET_BUF_USER_DATA_SIZE=8
CONFIG_NET_IPV4=y
CONFIG_NET_BUF_DATA_SIZE=1800
CONFIG_NET_DHCPV4=y
CONFIG_NET_IPV6=n
CONFIG_NET_BUF_RX_COUNT=128
CONFIG_NET_PKT_RX_COUNT=64
CONFIG_NET_BUF_TX_COUNT=32
CONFIG_NET_PKT_TX_COUNT=16
CONFIG_WIFI=y
CONFIG_WIFI_UWP=y
CONFIG_WIFI_UWP_USE_SRAM=y
CONFIG_WIFI_UWP_TOTAL_RX_ADDR_NUM=120

#CONFIG_ZTEST=y
#CONFIG_MINIMAL_LIBC_MALLOC_ARENA_SIZE=2048
CONFIG_PTHREAD_IPC=y
CONFIG_POSIX_MQUEUE=y
CONFIG_WIFIMGR=y
CONFIG_WIFIMGR_CLI=y
CONFIG_WIFIMGR_DHCPC=y

#TEST_RANDOM_GENERATOR=y
#TIMER_RANDOM_GENERATOR=y

CONFIG_NET_L2_ETHERNET=y
#CONFIG_NET_L2_WIFI_MGMT=y
#CONFIG_NET_L2_WIFI_SHELL=y

CONFIG_TEST=y

#CONFIG_FLASH=y
#CONFIG_SOC_FLASH_UWP360=y
#CONFIG_USE_UWP360_HAL_SFC=y

CONFIG_SIPC=y
CONFIG_IWNPI=n
CONFIG_ENGPC=n

#CONFIG_XIP=y

CONFIG_NET_SHELL=y

CONFIG_BT_UNISOC=y
CONFIG_BT_UNISOC_UWP56XX=y
CONFIG_BT=y
CONFIG_BT_SIPC=y
CONFIG_BT_SHELL=y
CONFIG_HEAP_MEM_POOL_SIZE=16384
CONFIG_MAIN_STACK_SIZE=4096
CONFIG_BT_HCI_TX_STACK_SIZE=4096
CONFIG_BT_RX_STACK_SIZE=4096
CONFIG_BT_RX_BUF_LEN=1024
CONFIG_BT_L2CAP_TX_MTU=255
CONFIG_BT_HCI_RESERVE=1
CONFIG_BT_PERIPHERAL=y
CONFIG_BT_CENTRAL=y
CONFIG_BT_DEVICE_NAME="BLUES"
CONFIG_BT_CONN=y
CONFIG_BT_HCI_ACL_FLOW_CONTROL=n
CONFIG_BT_ATT_PREPARE_COUNT=5

CONFIG_BT_MESH=y
CONFIG_BT_MESH_PROV=y
CONFIG_BT_MESH_HEALTH_CLI=y
CONFIG_BT_MESH_CFG_CLI=y
CONFIG_BT_MESH_SELF_TEST=y
CONFIG_BT_MESH_SHELL=y
CONFIG_BT_MESH_IV_UPDATE_TEST=y
CONFIG_BT_MESH_PB_GATT=y
CONFIG_BT_MESH_LOW_POWER=y
CONFIG_BT_MESH_FRIEND=y
CONFIG_BT_MESH_PROXY=y
CONFIG_BT_HCI_VS_EXT=n
CONFIG_BT_SETTINGS=y
CONFIG_BT_DEBUG_MONITOR=y
CONFIG_BT_DEBUG_LOG=y
CONFIG_THREAD_MONITOR=y
CONFIG_SYSTEM_WORKQUEUE_STACK_SIZE=4096

CONFIG_TEST_RANDOM_GENERATOR=y
CONFIG_TIMER_RANDOM_GENERATOR=y
```

## prj_xip.conf
```kconfig
# nothing here

CONFIG_BOOT_BANNER=n
CONFIG_BUILD_TIMESTAMP=y
CONFIG_STDOUT_CONSOLE=y
#CONFIG_BOOTLOADER_MCUBOOT=y
#CONFIG_FLASH_BASE_ADDRESS=0x180000
#CONFIG_TEXT_SECTION_OFFSET=0x200

CONFIG_CONSOLE_PULL=y
CONFIG_CONSOLE_SHELL=y
CONFIG_WATCHDOG=y

CONFIG_SYS_LOG=y
CONFIG_SYS_LOG_SHOW_COLOR=y
CONFIG_SYS_LOG_SHOW_TAGS=y
CONFIG_SYS_LOG_DEFAULT_LEVEL=2
CONFIG_SYS_LOG_OVERRIDE_LEVEL=2

CONFIG_FILE_SYSTEM=y
CONFIG_FAT_FILESYSTEM_ELM=y
CONFIG_FILE_SYSTEM_SHELL=y

CONFIG_DISK_ACCESS=y
CONFIG_DISK_ACCESS_FLASH=y
CONFIG_DISK_FLASH_DEV_NAME="UWP_FLASH"
CONFIG_DISK_FLASH_START=0x22C0000
CONFIG_DISK_FLASH_MAX_RW_SIZE=4096
CONFIG_DISK_FLASH_ERASE_ALIGNMENT=0x1000
CONFIG_DISK_ERASE_BLOCK_SIZE=4096
CONFIG_DISK_VOLUME_SIZE=0x80000

CONFIG_AON_UART_UWP=y

CONFIG_NETWORKING=y
CONFIG_NET_BUF=y
CONFIG_NET_BUF_USER_DATA_SIZE=8
CONFIG_NET_IPV4=y
CONFIG_NET_BUF_DATA_SIZE=1440
CONFIG_NET_DHCPV4=y
CONFIG_NET_IPV6=n
CONFIG_WIFI=y
CONFIG_WIFI_UWP=y

#TEST_RANDOM_GENERATOR=y
#TIMER_RANDOM_GENERATOR=y

CONFIG_NET_L2_ETHERNET=y
CONFIG_NET_L2_WIFI_MGMT=y
CONFIG_NET_L2_WIFI_SHELL=y

CONFIG_TEST=y

#CONFIG_FLASH=y
#CONFIG_SOC_FLASH_UWP360=y
#CONFIG_USE_UWP360_HAL_SFC=y

CONFIG_SIPC=y
##CONFIG_IWNPI=y
##CONFIG_ENGPC=y

CONFIG_NET_SHELL=y

CONFIG_XIP=y
CONFIG_BOOTLOADER_MCUBOOT=y
CONFIG_TEXT_SECTION_OFFSET=0x200

CONFIG_BT_UNISOC=y
CONFIG_BT_UNISOC_UWP56XX=y
CONFIG_BT=y
CONFIG_BT_SIPC=y
CONFIG_BT_SHELL=y
CONFIG_BT_RECV_IS_RX_THREAD=y
CONFIG_BT_RX_BUF_LEN=260
CONFIG_BT_HCI_RESERVE=4
CONFIG_BT_PERIPHERAL=y
CONFIG_BT_CENTRAL=y
#CONFIG_BT_DEBUG_MONITOR=y
```

## src/main.c
```c
/*
 * SPDX-License-Identifier: Apache-2.0
 */

#include <zephyr.h>
#include <misc/printk.h>

#include <gpio.h>
#include <watchdog.h>
#include <device.h>
#include <console.h>
#include <flash.h>
#include <shell/shell.h>
#include <string.h>
#include <misc/util.h>
#include <fs.h>
#include <uart.h>
#include <stdlib.h>
#include <logging/sys_log.h>

#include <fs.h>
#include <ff.h>

#include <net/net_if.h>
#include <net/net_core.h>
#include <net/net_context.h>
#include <net/net_mgmt.h>

#include "uwp_hal.h"
#include "bluetooth/blues.h"

#ifdef SYS_LOG_DOMAIN
#undef SYS_LOG_DOMAIN
#endif
#define SYS_LOG_DOMAIN	"UNISOC"

#define UART_2			"UART_2"

typedef void (*uwp_intc_callback_t) (int channel, void *user);
extern void uwp_intc_set_irq_callback(int channel,
		uwp_intc_callback_t cb, void *arg);
extern void uwp_intc_unset_irq_callback(int channel);
extern void uwp_aon_intc_set_irq_callback(int channel,
		uwp_intc_callback_t cb, void *arg);
extern void uwp_aon_intc_unset_irq_callback(int channel);

void device_list_get(struct device **device_list, int *device_count);

static struct net_mgmt_event_callback mgmt_cb;

static void handler(struct net_mgmt_event_callback *cb,
		    u32_t mgmt_event,
		    struct net_if *iface)
{
	int i = 0;

	if (mgmt_event != NET_EVENT_IPV4_ADDR_ADD) {
		return;
	}

	for (i = 0; i < NET_IF_MAX_IPV4_ADDR; i++) {
		char buf[NET_IPV4_ADDR_LEN];

		if (iface->config.ip.ipv4->unicast[i].addr_type !=
							NET_ADDR_DHCP) {
			continue;
		}

		SYS_LOG_WRN("Your address: %s",
			 net_addr_ntop(AF_INET,
			    &iface->config.ip.ipv4->unicast[i].address.in_addr,
				       buf, sizeof(buf)));
		SYS_LOG_WRN("Lease time: %u seconds",
			 iface->config.dhcpv4.lease_time);
		SYS_LOG_WRN("Subnet: %s",
			 net_addr_ntop(AF_INET,
				       &iface->config.ip.ipv4->netmask,
				       buf, sizeof(buf)));
		SYS_LOG_WRN("Router: %s",
			 net_addr_ntop(AF_INET, &iface->config.ip.ipv4->gw,
				       buf, sizeof(buf)));
	}
}

int dhcp_client(int argc, char **argv)
{
	struct device *dev;
	struct net_if *iface;

	SYS_LOG_WRN("Run dhcpv4 client");

	net_mgmt_init_event_callback(&mgmt_cb, handler,
				     NET_EVENT_IPV4_ADDR_ADD);
	net_mgmt_add_event_callback(&mgmt_cb);

	dev = device_get_binding(CONFIG_WIFI_UWP_STA_NAME);
	if (!dev) {
		SYS_LOG_ERR( "failed to get device %s!\n", CONFIG_WIFI_UWP_STA_NAME);
		return -1;
	}

	iface = net_if_lookup_by_dev(dev);
	if (!iface) {
		SYS_LOG_ERR("failed to get iface %s!\n", CONFIG_WIFI_UWP_STA_NAME);
		return -1;
	}

	net_dhcpv4_start(iface);

	return 0;
}

void print_devices(void)
{
	int i;
	int count = 0;

	static struct device *device_list;

	device_list_get(&device_list, &count);

	SYS_LOG_INF("device list(%d):", count);
	for(i = 0; i < count; i++) {
		SYS_LOG_INF(" %s ", device_list[i].config->name);
	}
}

void uart_test(void)
{
	struct device *uart;
	char *str = "This is a test message from test command.\r\n";

	uart = device_get_binding(UART_2);
	if(uart == NULL) {
		SYS_LOG_ERR("Can not find device %s.", UART_2);
		return;
	}

	uart_irq_rx_enable(uart);

	uart_fifo_fill(uart, str, strlen(str));

	SYS_LOG_INF("test uart %s finish.", UART_2);
}

static void intc_uwp_soft_irq(int channel, void *data)
{
	if(data) {
		SYS_LOG_INF("aon soft irq.");
		uwp_aon_irq_clear_soft();
	} else {
		SYS_LOG_INF("soft irq.");
		uwp_irq_clear_soft();
	}
}

static int test_cmd(int argc, char *argv[])
{
	if(argc < 2) return -EINVAL;

	if(!strcmp(argv[1], "flash")) {
		//spi_flash_test();
	}else if(!strcmp(argv[1], "uart")) {
		uart_test();
	}else if(!strcmp(argv[1], "intc")) {
		uwp_intc_set_irq_callback(INT_SOFT, intc_uwp_soft_irq, (void*)0);
		uwp_irq_enable(INT_SOFT);

		uwp_irq_trigger_soft();

		uwp_irq_disable(INT_SOFT);
		uwp_intc_unset_irq_callback(INT_SOFT);
	}else if(!strcmp(argv[1], "aon_intc")) {
		uwp_aon_intc_set_irq_callback(INT_SOFT, intc_uwp_soft_irq, (void*)1);
		uwp_aon_irq_enable(INT_SOFT);

		uwp_aon_irq_trigger_soft();

		uwp_aon_irq_disable(INT_SOFT);
		uwp_aon_intc_unset_irq_callback(INT_SOFT);
	}else {
		return -EINVAL;
	}

	return 0;
}

static int info_cmd(int argc, char *argv[])
{
	if(argc != 1) return -EINVAL;

	SYS_LOG_INF("System Info: \n");

	print_devices();

	return 0;
}

static int sleep_cmd(int argc, char *argv[])
{
	int time;

	if(argc != 2) return -EINVAL;

	time = atoi(argv[1]);
	SYS_LOG_INF("sleep %ims start...", time);

	k_sleep(time);

	SYS_LOG_INF("sleep stop.");

	return 0;
}

static int dev_cmd(int argc, char **argv)
{
	struct device *devices;
	int count;
	int i;

	device_list_get(&devices, &count);

	SYS_LOG_WRN("System device lists:");
	for (i = 0; i < count; i++, devices++) {
		if(strcmp(devices->config->name, "") == 0)
			continue;
		SYS_LOG_WRN("%d: %s.", i, devices->config->name);
	}

	return 0;
}

u32_t str2hex(char *s)
{
	u32_t val = 0;
	int len;
	int i;
	char c;

	if (strncmp(s, "0x", 2) && strncmp(s, "0X", 2)) {
		SYS_LOG_ERR("Invalid hex string: %s.", s);
		return 0;
	}

	/* skip 0x */
	s += 2;

	len = strlen(s);
	if(len > 8) {
		SYS_LOG_ERR("Invalid hex string.");
		return 0;
	}

	for (i = 0; i < len; i++) {
		c = *s;

		/* 0 - 9 */
		if(c >= '0' && c <= '9')
			c -= '0';
		else if (c >= 'A' && c <= 'F') 
			c = c - 'A' + 10;
		else if (c >= 'a' && c <= 'f')
			c = c - 'a' + 10;
		else {
			SYS_LOG_ERR("Invalid hex string.");
			return 0;
		}

		val = val * 16 + c;

		s++;
	}

	return val;
}

u32_t str2data(char *s)
{
	if (strncmp(s, "0x", 2) == 0 || strncmp(s, "0X", 2) == 0)
		return str2hex(s);
	else
		return atoi(s);
}

void read8_cmd_exe(u32_t addr, u32_t len)
{
	int i;
	SYS_LOG_WRN("Read %d bytes from 0x%x:", len, addr);

	for(i = 0; i < len; i++, addr++) {
		if(i%16 == 0) printk("\n%08x: ", addr );
		printk("%02x ", sys_read8(addr));
	}
	printk("\n");
}

static int read8_cmd(int argc, char **argv)
{
	u32_t addr;
	u32_t len;
	if(argc != 3) return -EINVAL;

	addr = (u32_t)str2data(argv[1]);
	len = str2data(argv[2]);

	read8_cmd_exe(addr, len);

	return 0;
}
void read32_cmd_exe(u32_t addr, u32_t len)
{
	int i;
	SYS_LOG_WRN("Read data from 0x%x:", addr);

	for(i = 0; i < len; i++, addr += 4) {
		if(i%4 == 0) printk("\n%08x: ", addr );
		printk("%08x ", sys_read32(addr));
	}
	printk("\n");
}

static int read32_cmd(int argc, char **argv)
{
	u32_t addr;
	u32_t len;
	if(argc != 3) return -EINVAL;

	addr = (u32_t)str2data(argv[1]);
	len = str2data(argv[2]);

	read32_cmd_exe(addr, len);

	return 0;
}

static int write_cmd(int argc, char **argv)
{
	u32_t p;
	u32_t val;
	if(argc != 3) return -EINVAL;

	p = str2data(argv[1]);
	val = str2data(argv[2]);

	sys_write32(val, p);

	SYS_LOG_INF("Write data 0x%x to address 0x%x success.",
			val, p);

	return 0;
}

extern int dhcp_client(int argc, char **argv);

static const struct shell_cmd zephyr_cmds[] = {
	{ "info", info_cmd, "" },
	{ "sleep", sleep_cmd, "time(ms)" },
	{ "test", test_cmd, "<flash|uart|intc|aon_intc>" },
	{ "device", dev_cmd, "" },
	{ "read8", read8_cmd, "adress len" },
	{ "read32", read32_cmd, "adress len" },
	{ "write32", write_cmd, "adress value" },
	{ "dhcp_client", dhcp_client, "" },
	{ NULL, NULL }
	//{ "iwnpi", iwnpi_cmd, "adress value" },
	//	{ "flash", flash_cmd, "mount|read|write address value" },
};

#define FATFS_MNTP "/NAND:"
/* FatFs work area */
static FATFS fat_fs;

/* mounting info */
static struct fs_mount_t fatfs_mnt = {
	.type = FS_FATFS,
	.mnt_point = FATFS_MNTP,
	.fs_data = &fat_fs,
};

void mount_file_system(void)
{
	int ret;
	ret = fs_mount(&fatfs_mnt);
	if (ret < 0) {
		SYS_LOG_ERR("Error mounting fs [%d]\n", ret);
	}
}

void main(void)
{
	SYS_LOG_WRN("Unisoc Wi-Fi Repeater.");

	SHELL_REGISTER("zephyr", zephyr_cmds);

	mount_file_system();

	blues_init();

	while(1) {}
}
```
