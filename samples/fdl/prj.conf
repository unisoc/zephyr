## CMakeLists.txt
```
include($ENV{ZEPHYR_BASE}/cmake/app/boilerplate.cmake NO_POLICY_SCOPE)
project(NONE)

target_sources(app PRIVATE src/main.c)
```

## prj.conf
```kconfig
# nothing here

CONFIG_BOOT_BANNER=n
CONFIG_BUILD_TIMESTAMP=y
CONFIG_STDOUT_CONSOLE=y
#CONFIG_BOOTLOADER_MCUBOOT=y
#CONFIG_FLASH_BASE_ADDRESS=0x180000
#CONFIG_TEXT_SECTION_OFFSET=0x200

CONFIG_SYS_LOG=y
CONFIG_SYS_LOG_SHOW_COLOR=y
CONFIG_SYS_LOG_SHOW_TAGS=y
CONFIG_SYS_LOG_DEFAULT_LEVEL=3
CONFIG_SYS_LOG_OVERRIDE_LEVEL=3

CONFIG_AON_UART_UWP=y


CONFIG_FLASH=y
#CONFIG_SOC_FLASH_UWP360=y
#CONFIG_USE_UWP360_HAL_SFC=y


CONFIG_XIP=n
```

## src/main.c
```c
/*
 * SPDX-License-Identifier: Apache-2.0
 */

#include <zephyr.h>
#include <misc/printk.h>

#include <gpio.h>
#include <watchdog.h>
#include <device.h>
#include <console.h>
#include <flash.h>
#include <shell/shell.h>
#include <string.h>
#include <misc/util.h>
#include <uart.h>
#include <stdlib.h>
#include <logging/sys_log.h>

#include "uwp_hal.h"

#ifdef SYS_LOG_DOMAIN
#undef SYS_LOG_DOMAIN
#endif
#define SYS_LOG_DOMAIN	"UNISOC"

#define UART_2			"UART_2"

void main(void)
{
	SYS_LOG_WRN("Unisoc fdl");



	while(1) {}
}
```
